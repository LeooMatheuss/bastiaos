## build/configs/bastiaos_defconfig
```kconfig
# BastiaOS Buildroot Configuration
# Based on ADR-0001: Build System Selection

# Architecture
BR2_x86_64=y
BR2_x86_core2=y

# Toolchain
BR2_TOOLCHAIN_BUILDROOT=y
BR2_TOOLCHAIN_BUILDROOT_GLIBC=y
BR2_TOOLCHAIN_BUILDROOT_CXX=y

# System configuration
BR2_TARGET_GENERIC_HOSTNAME="bastiaos"
BR2_TARGET_GENERIC_ISSUE="Welcome to BastiaOS\n"
BR2_TARGET_GENERIC_ROOT_PASSWD="root"
BR2_TARGET_GENERIC_GETTY_PORT="ttyS0"
BR2_TARGET_GENERIC_GETTY_BAUDRATE_115200=y

# Kernel
BR2_LINUX_KERNEL=y
BR2_LINUX_KERNEL_LATEST_VERSION=y
BR2_LINUX_KERNEL_USE_DEFCONFIG=y
BR2_LINUX_KERNEL_DEFCONFIG="bastiaos"

# Bootloader
BR2_TARGET_GRUB2=y
BR2_TARGET_GRUB2_BOOT_PARTITION="/dev/sda1"
BR2_TARGET_GRUB2_ROOT_PARTITION="/dev/sda2"

# Init system
BR2_INIT_SYSTEMD=y
BR2_PACKAGE_SYSTEMD=y

# Filesystem
BR2_TARGET_ROOTFS_EXT2=y
BR2_TARGET_ROOTFS_EXT2_4=y
BR2_TARGET_ROOTFS_EXT2_SIZE="256M"

# Essential packages
BR2_PACKAGE_BUSYBOX=y

# Network tools
BR2_PACKAGE_IFUPDOWN=y
BR2_PACKAGE_IPROUTE2=y
BR2_PACKAGE_IW=y
BR2_PACKAGE_WPA_SUPPLICANT=y
BR2_PACKAGE_WPA_SUPPLICANT_CLI=y
BR2_PACKAGE_WPA_SUPPLICANT_NL80211=y

# System utilities
BR2_PACKAGE_COREUTILS=y
BR2_PACKAGE_BASH=y
BR2_PACKAGE_VIM=y
BR2_PACKAGE_HTOP=y
BR2_PACKAGE_SCREEN=y
BR2_PACKAGE_TMUX=y

# Development tools
BR2_PACKAGE_GDB=y
BR2_PACKAGE_STRACE=y
BR2_PACKAGE_LTRACE=y

# Security
BR2_PACKAGE_OPENSSL=y
BR2_PACKAGE_OPENSSH=y
BR2_PACKAGE_CA_CERTIFICATES=y

# Compression
BR2_PACKAGE_XZ=y
BR2_PACKAGE_ZIP=y
BR2_PACKAGE_UNZIP=y

# Download location
BR2_DL_DIR="$(TOPDIR)/../dl"
BR2_BACKUP_SITE="https://sources.buildroot.org"

# Output directory
BR2_HOST_DIR="$(BASE_DIR)/host"

# Build options
BR2_PER_PACKAGE_DIRECTORIES=y
BR2_CCACHE=y
```
